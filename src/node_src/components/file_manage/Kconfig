## src/node_src/components/file_manage/Kconfig
```kconfig
menu "File Manager"
    config FILE_MANAGE_ENABLE_EXPLORER
        bool "Enable File Explorer"
        default n
        help
            Enable this option to enable the file explorer which can be used during testing.
            Disable this option when creating the final firmware as it is not needed.

endmenu
```

## src/node_src/components/flash/Kconfig.projbuild
```kconfig
menu "Pin Setup"

    config FLASH_LED
        int "Flash GPIO number"
        range 0 34
        default 4
        depends on FLASH_ENABLE
        help
            GPIO number (IOxx) to blink on and off.

            Some GPIOs are used for other purposes (flash connections, etc.) and cannot be used to blink.

            GPIOs 35-39 are input-only so cannot be used as outputs.

endmenu

menu "Features"

    config FLASH_ENABLE
        bool "Enable flash"
        default "n"
        help
            If the microcontroller supports (and you want) the camera to flash when pictures are taken, set this to "y".
    
    config FLASH_ONLY_WHEN_DARK
        bool "Only flash when dark"
        depends on FLASH_ENABLE
        default "y"
        help
            If the camera flash is enabled, this will only allow it to flash when the pixels detected by the camera are dark.
            This may result in a slightly more costly photo operation, as it will need to read an initial image and calculate the brightness.

endmenu
```

## src/node_src/main/Kconfig.projbuild
```kconfig
menu "Home Security"
    rsource "../components/file_manage/Kconfig"
    rsource "../components/flash/Kconfig"
    rsource "../components/esp32-camera/Kconfig"
endmenu
```

## src/node_src/sdkconfig.defaults
```kconfig
# Copy any lines from sdkconfig to here. These will be the new default values.
# Lines added to this file will not affect the build process while the sdkconfig file exists.
# Once the project is finished, the sdkconfig can be untracked and only this file will be on the repo.

CONFIG_ESP32_SPIRAM_SUPPORT=y
```
